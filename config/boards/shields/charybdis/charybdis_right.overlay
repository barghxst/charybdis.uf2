/*
 * Copyright (c) 2020 ZMK Contributors
 *
 * SPDX-License-Identifier: MIT
 */

/*
 * charybdis_right — BLUETOOTH mode: the right half is the BLE central, talks
 * to the host directly over USB/BLE, and carries the trackball locally.
 * (For dongle mode the right half is a peripheral: see charybdis_right_dongle.)
 */

#include "charybdis.dtsi"
#include "trackball-sensor.dtsi"

&default_transform {
    col-offset = <6>;
};

&kscan0 {
	compatible = "zmk,kscan-gpio-matrix";

	col-gpios
		= <&gpio0 2 (GPIO_ACTIVE_HIGH | GPIO_PULL_DOWN)>
		, <&gpio0 29 (GPIO_ACTIVE_HIGH | GPIO_PULL_DOWN)>
		, <&gpio0 9 (GPIO_ACTIVE_HIGH | GPIO_PULL_DOWN)>
		, <&gpio1 0  (GPIO_ACTIVE_HIGH | GPIO_PULL_DOWN)>
		, <&gpio0 11 (GPIO_ACTIVE_HIGH | GPIO_PULL_DOWN)>
		, <&gpio1 4  (GPIO_ACTIVE_HIGH | GPIO_PULL_DOWN)>
		;
};

// Bluetooth mode has no split pointing — the central owns the sensor directly,
// so the listener binds straight to &trackball and the split proxy is unused.
&trackball_split {
    status = "disabled";
};

#define TRACKBALL_INPUT_DEVICE &trackball
#include "trackball-input.dtsi"
